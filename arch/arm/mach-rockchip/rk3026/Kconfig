## board/rockchip/onyx-rc2/Kconfig
```kconfig
if TARGET_ONYX_RC2

config SYS_BOARD
	default "onyx-rc2"

config SYS_VENDOR
	default "rockchip"

config SYS_CONFIG_NAME
	default "onyx_rc2"

config RC2_RESET_METHOD
	string "Default reset method (core, fst or snd)"
	default "core"
	help
	  How the "reset" command (and anything else that asks the sysreset
	  uclass for a reset) resets the RK3026. The environment variable
	  rc2_reset overrides it at run time, so the device test can try
	  every method without a rebuild.

	  core: the stock 3.0 kernel's way, from IMEM: all PLLs to slow
	        mode, then SOFTRST_CON0 = 0x801cffff (MCORE, CORE0, CORE1,
	        L2C). The GPIO banks, the GRF, IMEM and the DDR controller
	        keep their state, so the ACT8931 power hold (GPIO1_A2) stays
	        up: on battery the book restarts (U-Boot "reset" with the
	        cable pulled: Linux back 9 s later, pstore kept; 2026-10-18).
	        The stock kernel's reboot from SD lands on the SD.
	  fst:  CRU_GLB_SRST_FST_VALUE = 0xfdb9 (first global reset). On the
	        book after a mainline "reboot" it ran ROM -> FlashData ->
	        stage2 from the SD again (2026-10-17). Resets the GPIO banks
	        (2026-10-18): on battery the power hold drops and the book
	        switches off. After it the host did not see U-Boot's ACM
	        port again.
	  snd:  CRU_GLB_SRST_SND_VALUE = 0xeca8 (second global reset; keeps
	        the GRF, resets the GPIO banks like fst: on battery the book
	        switches off, 2026-10-18).

	  Every method first cleans and disables the caches and clears the
	  IMEM remap. With the cable in all three bring the BootROM back to
	  the microSD card; on battery only core does (book rounds of
	  2026-10-17 and 2026-10-18).

endif
```

## configs/onyx_rc2_mspl_defconfig
```kconfig
CONFIG_ARM=y
CONFIG_ARCH_ROCKCHIP=y
CONFIG_TEXT_BASE=0x60000000
CONFIG_NR_DRAM_BANKS=1
CONFIG_HAS_CUSTOM_SYS_INIT_SP_ADDR=y
CONFIG_CUSTOM_SYS_INIT_SP_ADDR=0x60100000
CONFIG_DEFAULT_DEVICE_TREE="rk3026-onyx-rc2"
CONFIG_ROCKCHIP_RK3026=y
CONFIG_TARGET_ONYX_RC2=y
CONFIG_SPL=y
CONFIG_SPL_SKIP_LOWLEVEL_INIT_ONLY=y
# CONFIG_SPL_SKIP_LOWLEVEL_INIT is not set
CONFIG_SPL_LIBGENERIC_SUPPORT=y
CONFIG_SPL_ROCKCHIP_BACK_TO_BROM=y
CONFIG_SPL_STACK_R_ADDR=0x80000
CONFIG_SPL_STACK=0x10081fff
CONFIG_SPL_TEXT_BASE=0x10080800
CONFIG_SPL_STACK_R=y
CONFIG_SPL_LIBCOMMON_SUPPORT=y
CONFIG_SPL_CYCLIC=y
CONFIG_SPL_NO_BSS_LIMIT=y
CONFIG_SPL_HAVE_INIT_STACK=y
# CONFIG_SPL_SERIAL is not set
CONFIG_SPL_TINY_MEMSET=y
# CONFIG_SPL_USE_ARCH_MEMCPY is not set
# CONFIG_SPL_USE_ARCH_MEMSET is not set
# CONFIG_SPL_FRAMEWORK is not set
# CONFIG_SPL_DOS_PARTITION is not set
# CONFIG_SPL_EFI_PARTITION is not set
# CONFIG_SPL_SYSRESET is not set
# CONFIG_RK3026_SPL_TIMER_STASH is not set
CONFIG_SYS_LOAD_ADDR=0x61000000
CONFIG_PRE_CON_BUF_ADDR=0x60f00000
CONFIG_PRE_CON_BUF_SZ=8192
CONFIG_DEFAULT_FDT_FILE="rk3026-onyx-rc2.dtb"
CONFIG_PRE_CONSOLE_BUFFER=y
CONFIG_CONSOLE_MUX=y
CONFIG_BOARD_EARLY_INIT_F=y
CONFIG_CYCLIC=y
CONFIG_BOOTDELAY=2
CONFIG_USE_BOOTCOMMAND=y
CONFIG_BOOTCOMMAND="run rc2_bootcmd"
CONFIG_USE_PREBOOT=y
CONFIG_PREBOOT=""
CONFIG_BOOTCOUNT_LIMIT=y
CONFIG_BOOTCOUNT_GENERIC=y
CONFIG_SYS_BOOTCOUNT_ADDR=0x7fff6000
CONFIG_SYSCON=y
CONFIG_CLK=y
CONFIG_PINCTRL=y
CONFIG_SYS_NS16550_MEM32=y
CONFIG_SYSRESET=y
CONFIG_TIMER=y
CONFIG_ROCKCHIP_TIMER=y
CONFIG_ARM_GLOBAL_TIMER=y
CONFIG_WDT=y
CONFIG_DESIGNWARE_WATCHDOG=y
CONFIG_CMD_WDT=y
# CONFIG_WATCHDOG_AUTOSTART is not set
CONFIG_USB=y
CONFIG_USB_GADGET=y
CONFIG_USB_GADGET_MANUFACTURER="ONYX"
CONFIG_USB_GADGET_PRODUCT_NUM=0x0010
CONFIG_USB_GADGET_DWC2_OTG=y
CONFIG_USB_FUNCTION_ACM=y
CONFIG_USB_GADGET_DOWNLOAD=y
CONFIG_USB_FUNCTION_MASS_STORAGE=y
CONFIG_CMD_USB_MASS_STORAGE=y
CONFIG_MMC_DW=y
CONFIG_MMC_DW_ROCKCHIP=y
# CONFIG_CMD_MMC is not set
# CONFIG_MMC_HW_PARTITIONING is not set
# CONFIG_FAT_WRITE is not set
# CONFIG_CMD_SAVEENV is not set
# CONFIG_CMD_BIND is not set
# CONFIG_CMD_SF is not set
# CONFIG_CMD_I2C is not set
# CONFIG_EFI_LOADER is not set
CONFIG_BOOTSTAGE=y
CONFIG_BOOTSTAGE_REPORT=y
CONFIG_CMD_BOOTSTAGE=y
CONFIG_CMD_CLK=y
CONFIG_CMD_CACHE=y
CONFIG_CMD_STRINGS=y
CONFIG_CMD_PSTORE=y
CONFIG_CMD_PSTORE_MEM_ADDR=0x7ff40000
CONFIG_CMD_PSTORE_MEM_SIZE=0x80000
CONFIG_CMD_PSTORE_RECORD_SIZE=0x20000
CONFIG_CMD_PSTORE_CONSOLE_SIZE=0x40000
CONFIG_CMD_PSTORE_FTRACE_SIZE=0x0
CONFIG_CMD_PSTORE_PMSG_SIZE=0x0
# CONFIG_DISPLAY_CPUINFO is not set
# CONFIG_DISPLAY_BOARDINFO is not set
# CONFIG_FASTBOOT is not set
# CONFIG_CMD_FASTBOOT is not set
# CONFIG_USB_FUNCTION_FASTBOOT is not set
CONFIG_NO_NET=y
# CONFIG_BOOTSTD_BOOTCOMMAND is not set
# CONFIG_DM_I2C is not set
# CONFIG_DM_REGULATOR is not set
# CONFIG_SPI is not set
# CONFIG_DM_SPI is not set
# CONFIG_SPI_FLASH is not set
# CONFIG_DM_SPI_FLASH is not set
# CONFIG_MTD is not set
# CONFIG_ADC is not set
# CONFIG_SARADC_ROCKCHIP is not set
# CONFIG_DM_PWM is not set
# CONFIG_I2C is not set
CONFIG_SKIP_LOWLEVEL_INIT_ONLY=y
```
